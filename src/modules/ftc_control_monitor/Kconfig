## src/modules/ftc_control_monitor/Kconfig
```kconfig
menuconfig MODULES_FTC_CONTROL_MONITOR
	bool "ftc_control_monitor"
	default n
	depends on MODULES_CONTROL_ALLOCATOR && MODULES_MOTOR_HEALTH_MONITOR
	---help---
		Enable dynamic allocation shadow and remaining control authority observation
```

## src/modules/ftc_extreme_state_monitor/Kconfig
```kconfig
menuconfig MODULES_FTC_EXTREME_STATE_MONITOR
	bool "ftc_extreme_state_monitor"
	default n
	depends on MODULES_MOTOR_HEALTH_MONITOR
	---help---
		Enable impact, hard-landing and loss-of-control observation
```

## src/modules/ftc_recovery/Kconfig
```kconfig
menuconfig MODULES_FTC_RECOVERY
	bool "ftc_recovery"
	default n
	depends on MODULES_FTC_EXTREME_STATE_MONITOR && MODULES_FTC_CONTROL_MONITOR
	---help---
		Enable the gated recovery manager and disconnected candidate controller
```

## src/modules/ftc_supervisor/Kconfig
```kconfig
menuconfig MODULES_FTC_SUPERVISOR
	bool "ftc_supervisor"
	default n
	depends on MODULES_MOTOR_HEALTH_MONITOR
	---help---
		Enable the read-only FTC subsystem supervisor
```

## src/modules/motor_health_monitor/Kconfig
```kconfig
menuconfig MODULES_MOTOR_HEALTH_MONITOR
	bool "motor_health_monitor"
	default n
	---help---
		Enable the read-only motor effectiveness and health monitor
```
